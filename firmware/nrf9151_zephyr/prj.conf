## CMakeLists.txt
```
#
# Copyright (c) 2018 Nordic Semiconductor ASA
#
# SPDX-License-Identifier: LicenseRef-Nordic-5-Clause
#

cmake_minimum_required(VERSION 3.20.0)

find_package(Zephyr REQUIRED HINTS $ENV{ZEPHYR_BASE})
project(IOT_PIPELINE)



# NORDIC SDK APP START

target_sources(app PRIVATE
    src/main.c
    src/mqtt_connection.c
    modules/bosch/bmp581/bmp5.c
)

# Add include directories

target_include_directories(app PRIVATE
     include
     modules/bosch/bmp581
) # To find "sen55.h"
```

## Kconfig
```
#
# Copyright (c) 2020 Nordic Semiconductor ASA
#
# SPDX-License-Identifier: LicenseRef-Nordic-5-Clause
#

menu "LTE MQTT IoT Pipeline Example"

config GNSS_ERASE
	string "GNSS erase command"
	default "ERASE"
		
config BOARD_RESET
	string "Board reset command"
	default "RESET"
	
config MQTT_PUB_TOPIC
	string "MQTT publish topic"
	default "devices/example-device/telemetry"

config MQTT_PUB_TOPIC1
	string "MQTT publish topic"
	default "devices/example-device/location"

config MQTT_SUB_TOPIC
	string "MQTT subscribe topic"
	default "devices/example-device/commands"

config MQTT_CLIENT_ID
	string "MQTT Client ID"
	help
	  Use a custom Client ID string. If not set, the client ID will be
	  generated based on IMEI number (for nRF91 Series based targets) or
	  randomly (for other platforms).
	default ""

config MQTT_BROKER_HOSTNAME
	string "MQTT broker hostname"
	default "mqtt.example.com"

config MQTT_BROKER_PORT
	int "MQTT broker port"
	default 1883

config MQTT_MESSAGE_BUFFER_SIZE
	int "MQTT message buffer size"
	default 128

config MQTT_PAYLOAD_BUFFER_SIZE
	int "MQTT payload buffer size"
	default 128

config BUTTON_EVENT_PUBLISH_MSG
	string "The message to publish on a button event"
	default "Hi from nRF91 Series device"

config TURN_LED_ON_CMD
	string "Command to turn on LED"
	default "LED1ON"

config TURN_LED_OFF_CMD
	string "Command to turn off LED"
	default "LED1OFF"

config MQTT_RECONNECT_DELAY_S
	int "Seconds to delay before attempting to reconnect to the broker."
	default 60


config GNSS_PERIODIC_INTERVAL
	int "Fix interval for periodic GPS fixes"
	range 10 65535
	default 10
	help
	  Fix interval (in seconds) for periodic fixes.


config GNSS_PERIODIC_TIMEOUT
	int "Fix timeout for periodic GPS fixes"
	range 0 65535
	default 600
	help
	  Fix timeout (in seconds) for periodic fixes.
	  If set to zero, GNSS is allowed to run indefinitely until a valid PVT estimate is produced.

endmenu



menu "Zephyr Kernel"
source "Kconfig.zephyr"
endmenu
```

## sample.yaml
```
sample:
  description: Sanitized nRF9151 LTE/GNSS MQTT environmental sensor example
  name: Embedded LTE MQTT IoT Pipeline
  
common: 
    sysbuild: true
    build_only: true
    integration_platforms: 
      - nrf9151dk/nrf9151/ns
      - nrf9161dk/nrf9161/ns
      - nrf9160dk/nrf9160/ns
      - thingy91x/nrf9151/ns
      - thingy91/nrf9160/ns
    platform_exclude:
      - native_sim
    
tests:
  firmware.nrf9151_zephyr: {}
```

## prj.conf
```kconfig
#
# Copyright (c) 2020 Nordic Semiconductor ASA
#
# SPDX-License-Identifier: LicenseRef-Nordic-5-Clause
#

# Logging
CONFIG_LOG=y

# Button and LED support
CONFIG_DK_LIBRARY=y

# Newlib
CONFIG_NEWLIB_LIBC=y
CONFIG_NEWLIB_LIBC_FLOAT_PRINTF=y

# Networking
CONFIG_NETWORKING=y
CONFIG_NET_NATIVE=n
CONFIG_NET_SOCKETS_OFFLOAD=y
CONFIG_NET_SOCKETS=y
CONFIG_POSIX_API=y

# Memory
CONFIG_MAIN_STACK_SIZE=8192
CONFIG_HEAP_MEM_POOL_SIZE=1024

# Modem library
CONFIG_NRF_MODEM_LIB=y

# LTE link control
CONFIG_LTE_LINK_CONTROL=y
CONFIG_LTE_NETWORK_MODE_LTE_M_NBIOT=y

# MQTT
# STEP 2.1 - Enable and configure the MQTT library
CONFIG_MQTT_LIB=y
CONFIG_MQTT_CLEAN_SESSION=y

# Application
CONFIG_MQTT_PUB_TOPIC="devices/example-device/telemetry"
CONFIG_MQTT_PUB_TOPIC1="devices/example-device/location"
CONFIG_MQTT_BROKER_HOSTNAME="mqtt.example.com"
CONFIG_MQTT_BROKER_PORT=1883

CONFIG_GNSS_ERASE="ERASE"
CONFIG_BOARD_RESET="RESET"

#i2c configuration
CONFIG_I2C=y            # i2c function add
CONFIG_I2C_NRFX=y

CONFIG_NRFX_TWIM0=n
CONFIG_NRFX_TWIM1=n
CONFIG_NRFX_TWIM2=y
CONFIG_NRFX_TWIM3=y


CONFIG_PRINTK=y      
CONFIG_CONSOLE=y          
CONFIG_UART_CONSOLE=y 
CONFIG_SERIAL=y           
CONFIG_SENSOR=y


CONFIG_ASSERT=y
CONFIG_I2C_LOG_LEVEL_DBG=y
CONFIG_LOG_MODE_IMMEDIATE=y


CONFIG_CBPRINTF_FP_SUPPORT=y   # float %f 
CONFIG_MQTT_KEEPALIVE=120

CONFIG_MQTT_MESSAGE_BUFFER_SIZE=1024

CONFIG_NET_IPV4=y

#GNSS
CONFIG_LTE_NETWORK_MODE_LTE_M_NBIOT_GPS=y
CONFIG_MODEM_ANTENNA_GNSS_EXTERNAL=n
CONFIG_FPU=y

CONFIG_MODEM_ANTENNA=y
CONFIG_MODEM_ANTENNA_AT_COEX0="AT%XCOEX0=1,1,1570,1580"


#Watchdog
CONFIG_WATCHDOG=y


CONFIG_HWINFO=y


#PSM
CONFIG_LTE_PSM_REQ=y
CONFIG_LTE_LC_PSM_MODULE=y

CONFIG_LTE_LC_EDRX_MODULE=y
CONFIG_LTE_EDRX_REQ=y

#datetime
CONFIG_DATE_TIME=y
CONFIG_DATE_TIME_MODEM=y
CONFIG_DATE_TIME_AUTO_UPDATE=y
CONFIG_DATE_TIME_NTP=y



CONFIG_COUNTER=y


#ADC
CONFIG_ADC=y

#SPI
CONFIG_SPI=y
CONFIG_FLASH=y
CONFIG_FLASH_MAP=y
CONFIG_SPI_NOR=y
CONFIG_FLASH_PAGE_LAYOUT=y

#TFM silent log
CONFIG_TFM_LOG_LEVEL_SILENCE=y


CONFIG_SYSTEM_WORKQUEUE_STACK_SIZE=2048
CONFIG_HEAP_MEM_POOL_SIZE=2048


CONFIG_REBOOT=y

CONFIG_GNSS_PERIODIC_TIMEOUT=780



CONFIG_NEWLIB_LIBC_NANO=n
```

## include/config.h
```c
#ifndef CONFIG_H
#define CONFIG_H

#define GNSS_FLAG_OFFSET  0x01F00000
#define SECTOR_SIZE 4096

extern char topic_sub[64];

#endif
```

## include/secrets.example.h
```c
#ifndef SECRETS_EXAMPLE_H
#define SECRETS_EXAMPLE_H

/*
 * Copy this file to secrets.h for private local builds.
 * Keep the real secrets.h file out of Git.
 */

#define SENSOR_ID       "devices/example-device/telemetry"
#define MQTT_LOG        "devices/example-device/logs"

#define MQTT_BROKER     "mqtt.example.com"
#define MQTT_PORT       1883

#define PINNUMBER       ""
#define APN             "your.apn.example"
#define APN_USER        "your-apn-user"
#define APN_PASSWORD    "your-apn-password"

#endif
```

## include/sen55.h
```c
#ifndef SEN55_H
#define SEN55_H

#include <zephyr/device.h>
#include <zephyr/IOT_PIPELINEvers/i2c.h>
#include <stdint.h>


#define SEN55_I2C_ADDR 0x69
#define SEN55_DATA_LEN 48


struct sen55_data {
    float pm1p0;
    float pm2p5;
    float pm4p0;
    float pm10p0;
    float temperature;
    float humidity;
    float voc_index;
    float nox_index;
};

int sen55_start_measurement(const struct device *i2c_dev);
int sen55_read_raw_data(const struct device *i2c_dev, uint8_t *buf, size_t len);
int sen55_parse_data(const uint8_t *buf, struct sen55_data *out);



#endif
```

## src/mqtt_connection.c
```c
#include <stdio.h>
#include <string.h>
#include <ncs_version.h>

#include <zephyr/logging/log.h>
#include <zephyr/sys/reboot.h>

#include <zephyr/kernel.h>
#include <zephyr/net/socket.h>
#include <zephyr/net/mqtt.h>
#include <nrf_modem_at.h>

//#include <dk_buttons_and_leds.h>
#include "mqtt_connection.h"
#include <config.h>
#include <zephyr/random/random.h>
#include <zephyr/IOT_PIPELINEvers/flash.h>



volatile bool mqtt_connected = false;

/* Buffers for MQTT client. */
static uint8_t rx_buffer[CONFIG_MQTT_MESSAGE_BUFFER_SIZE];
static uint8_t tx_buffer[CONFIG_MQTT_MESSAGE_BUFFER_SIZE];
static uint8_t payload_buf[CONFIG_MQTT_PAYLOAD_BUFFER_SIZE];

/* MQTT Broker details. */
static struct sockaddr_storage broker;

LOG_MODULE_DECLARE(IOT_PIPELINE);

/**@brief Function to get the payload of recived data.
 */
static int get_received_payload(struct mqtt_client *c, size_t length)
{
	int ret;
	int err = 0;

	/* Return an error if the payload is larger than the payload buffer.
	 * Note: To allow new messages, we have to read the payload before returning.
	 */
	if (length > sizeof(payload_buf)) {
		err = -EMSGSIZE;
	}

	/* Truncate payload until it fits in the payload buffer. */
	while (length > sizeof(payload_buf)) {
		ret = mqtt_read_publish_payload_blocking(
				c, payload_buf, (length - sizeof(payload_buf)));
		if (ret == 0) {
			return -EIO;
		} else if (ret < 0) {
			return ret;
		}

		length -= ret;
	}

	ret = mqtt_readall_publish_payload(c, payload_buf, length);
	if (ret) {
		return ret;
	}

	return err;
}

/**@brief Function to subscribe to the configured topic
 */
// static int subscribe(struct mqtt_client *const c)
// {
// 	struct mqtt_topic subscribe_topic = {
// 		.topic = {
// 			.utf8 = topic_sub,
// 			.size = strlen(topic_sub)
// 		},
// 		.qos = MQTT_QOS_1_AT_LEAST_ONCE
// 	};

// 	const struct mqtt_subscription_list subscription_list = {
// 		.list = &subscribe_topic,
// 		.list_count = 1,
// 		.message_id = 1234
// 	};

// 	LOG_INF("Subscribing to: %s len %u", topic_sub,
// 		(unsigned int)strlen(topic_sub));

// 	return mqtt_subscribe(c, &subscription_list);
// }

/**@brief Function to print strings without null-termination
 */
static void data_print(uint8_t *prefix, uint8_t *data, size_t len)
{
	char buf[len + 1];

	memcpy(buf, data, len);
	buf[len] = 0;
	printk("%s%s", (char *)prefix, (char *)buf);
}

/**@brief Function to publish data on the configured topic
 */
/* STEP 7.1 - Define the function data_publish() to publish data */
int data_publish(struct mqtt_client *c, enum mqtt_qos qos,
	uint8_t *data, size_t len, char *topic)
{
	struct mqtt_publish_param param;

	param.message.topic.qos = qos;
	param.message.topic.topic.utf8 = topic;
	param.message.topic.topic.size = strlen(topic);
	param.message.payload.data = data;
	param.message.payload.len = len;
	param.message_id = sys_rand32_get();
	param.dup_flag = 0;
	param.retain_flag = 0;

	data_print("[MongoDB] Publishing: \r\n", data, len);
	printk("To topic: %s len: %u\r\n",
		topic,
		(unsigned int)strlen(topic));
	printk("...\r\n");

	return mqtt_publish(c, &param);
}

int data_publish_satelite(struct mqtt_client *c, enum mqtt_qos qos,
	uint8_t *data, size_t len, char *topic)
{
	struct mqtt_publish_param param;

	param.message.topic.qos = qos;
	param.message.topic.topic.utf8 = topic;
	param.message.topic.topic.size = strlen(topic);
	param.message.payload.data = data;
	param.message.payload.len = len;
	param.message_id = sys_rand32_get();
	param.dup_flag = 0;
	param.retain_flag = 0;

	data_print("[GNSS] Publishing: \r\n", data, len);
	printk("[GNSS] To topic: %s len: %u\r\n",
		topic,
		(unsigned int)strlen(topic));
	printk("...\r\n");
	printk("...\r\n");
	
	return mqtt_publish(c, &param);
}

/**@brief MQTT client event handler
 */
void mqtt_evt_handler(struct mqtt_client *const c,
		      const struct mqtt_evt *evt)
{
	int err;

	switch (evt->type) {
	case MQTT_EVT_CONNACK:
	/* STEP 5 - Subscribe to the topic CONFIG_MQTT_SUB_TOPIC when we have a successful connection */
		if (evt->result == 0) {
            mqtt_connected = true;
            LOG_INF("[MQTT] CONNACK received → connected");
        } else {
            mqtt_connected = false;
            LOG_ERR("[MQTT] CONNACK error: %d", evt->result);
        }
        break;
		

	case MQTT_EVT_DISCONNECT:
		mqtt_connected = false;
        LOG_WRN("[MQTT] Disconnected");
        break;

	case MQTT_EVT_PUBLISH:
	/* STEP 6 - Listen to published messages received from the broker and extract the message */
	{
		/* STEP 6.1 - Extract the payload */
		const struct mqtt_publish_param *p = &evt->param.publish;
		//Print the length of the recived message 
		LOG_INF("MQTT PUBLISH result=%d len=%d",
			evt->result, p->message.payload.len);

		//Extract the data of the recived message 
		err = get_received_payload(c, p->message.payload.len);
		
		//Send acknowledgment to the broker on receiving QoS1 publish message 
		if (p->message.topic.qos == MQTT_QOS_1_AT_LEAST_ONCE) {
			const struct mqtt_puback_param ack = {
				.message_id = p->message_id
			};

			/* Send acknowledgment. */
			mqtt_publish_qos1_ack(c, &ack);
		}

		

		/* STEP 6.2 - On successful extraction of data */
		if (err >= 0) {
			data_print("Received: ", payload_buf, p->message.payload.len);
			
			
			

		// Payload buffer is smaller than the received data 
		} else if (err == -EMSGSIZE) {
			LOG_ERR("Received payload (%d bytes) is larger than the payload buffer size (%d bytes).",
				p->message.payload.len, sizeof(payload_buf));
		// Failed to extract data, disconnect 
		} else {
			LOG_ERR("get_received_payload failed: %d\r\n", err);
			LOG_INF("Disconnecting MQTT client...\r\n");

			err = mqtt_disconnect(c, NULL);
			if (err) {
				LOG_ERR("Could not disconnect: %d \r\n", err);
			}
		}
	} break;

	case MQTT_EVT_PUBACK:
		if (evt->result != 0) {
			LOG_ERR("MQTT PUBACK error: %d", evt->result);
			break;
		}

		LOG_INF("PUBACK packet id: %u", evt->param.puback.message_id);
		break;

	case MQTT_EVT_SUBACK:
		if (evt->result != 0) {
			LOG_ERR("MQTT SUBACK error: %d", evt->result);
			break;
		}

		LOG_INF("SUBACK packet id: %u", evt->param.suback.message_id);
		break;

	case MQTT_EVT_PINGRESP:
		if (evt->result != 0) {
			LOG_ERR("MQTT PINGRESP error: %d", evt->result);
		}
		break;

	default:
		LOG_INF("Unhandled MQTT event type: %d", evt->type);
		break;
	}
}


/**@brief Resolves the configured hostname and
 * initializes the MQTT broker structure
 */
 static int broker_init(void)
 {
 	int err;
 	struct adIOT_PIPELINEnfo *result;
 	struct adIOT_PIPELINEnfo *addr;
 	struct adIOT_PIPELINEnfo hints = {
 		.ai_family = AF_INET,  //ipv4 it is saying which one should i take
 		.ai_socktype = SOCK_STREAM //tcp
 	};

 	err = getadIOT_PIPELINEnfo(CONFIG_MQTT_BROKER_HOSTNAME, NULL, &hints, &result);
 	if (err) {
 		LOG_ERR("getadIOT_PIPELINEnfo failed: %d", err);
 		return -ECHILD;
 	}

 	addr = result;

 	/* Look for address of the broker. */
 	while (addr != NULL) {
 		/* IPv4 Address. */
 		if (addr->ai_addrlen == sizeof(struct sockaddr_in)) {
 			struct sockaddr_in *broker4 =
 				((struct sockaddr_in *)&broker);
 			char ipv4_addr[NET_IPV4_ADDR_LEN];

 			broker4->sin_addr.s_addr =
 				((struct sockaddr_in *)addr->ai_addr)
 				->sin_addr.s_addr;
 			broker4->sin_family = AF_INET; //ipv4
 			broker4->sin_port = htons(CONFIG_MQTT_BROKER_PORT); //port number

			inet_ntop(AF_INET, &broker4->sin_addr.s_addr, // Convert to read the person
 				  ipv4_addr, sizeof(ipv4_addr));
			
 			printk("[IPv4] TCP Address found %s\r\n", (char *)(ipv4_addr));
			k_sleep(K_MSEC(100));
 			break;
 		} else {
 			LOG_ERR("ai_addrlen = %u should be %u or %u",
 				(unsigned int)addr->ai_addrlen,
 				(unsigned int)sizeof(struct sockaddr_in),
 				(unsigned int)sizeof(struct sockaddr_in6));
 		}

		addr = addr->ai_next;
	}

 	/* Free the address. */
 	freeadIOT_PIPELINEnfo(result);

 	return err;
 }

/* Function to get the client id */
static const uint8_t* client_id_get(void)
{
	static uint8_t client_id[MAX(sizeof(CONFIG_MQTT_CLIENT_ID),
				     CLIENT_ID_LEN)];

	if (strlen(CONFIG_MQTT_CLIENT_ID) > 0) {
		snprintf(client_id, sizeof(client_id), "%s",
			 CONFIG_MQTT_CLIENT_ID);
		goto exit;
	}

	char imei_buf[CGSN_RESPONSE_LENGTH + 1];
	int err;

	err = nrf_modem_at_cmd(imei_buf, sizeof(imei_buf), "AT+CGSN");
	if (err) {
		LOG_ERR("Failed to obtain IMEI, error: %d", err);
		goto exit;
	}

	
	imei_buf[IMEI_LEN] = '\0';

	snprintf(client_id, sizeof(client_id), "nrf-%.*s", IMEI_LEN, imei_buf);

exit:
	LOG_DBG("client_id = %s", (char *)(client_id));

	return client_id;
}


/**@brief Initialize the MQTT client structure
 */

int client_init(struct mqtt_client *client)
{
	int err;
	/* Initializes the client instance. */
	mqtt_client_init(client);

	/* Resolves the configured hostname and initializes the MQTT broker structure */
	err = broker_init();
	if (err) {
		LOG_ERR("Failed to initialize broker connection");
		return err;
	}

	client->broker = &broker;
	client->evt_cb = mqtt_evt_handler;
	client->client_id.utf8 = client_id_get();
	client->client_id.size = strlen(client->client_id.utf8);
	client->password = NULL;
	client->user_name = NULL;
	client->protocol_version = MQTT_VERSION_3_1_1;
	 

	/* MQTT buffers configuration */
	client->rx_buf = rx_buffer;
	client->rx_buf_size = sizeof(rx_buffer);
	client->tx_buf = tx_buffer;
	client->tx_buf_size = sizeof(tx_buffer);

	/* We are not using TLS in Exercise 1 */
	client->transport.type = MQTT_TRANSPORT_NON_SECURE;


	return err;
}

/**@brief Initialize the file descriptor structure used by poll.
 */
int fds_init(struct mqtt_client *c, struct pollfd *fds)
{
	if (c->transport.type == MQTT_TRANSPORT_NON_SECURE) {
		fds->fd = c->transport.tcp.sock;
	} else {
		return -ENOTSUP;
	}

	fds->events = POLLIN;

	return 0;
}
```

## src/mqtt_connection.h
```c
#ifndef _MQTTCONNECTION_H_
#define _MQTTCONNECTION_H_
#define LED_CONTROL_OVER_MQTT          DK_LED1 /*The LED to control over MQTT*/
#define IMEI_LEN 15
#define CGSN_RESPONSE_LENGTH (IMEI_LEN + 6 + 1) /* Add 6 for \r\nOK\r\n and 1 for \0 */
#define CLIENT_ID_LEN sizeof("nrf-") + IMEI_LEN

#pragma once
#include <stdbool.h>

extern volatile bool mqtt_connected;

int publish_sensor_data(const char *device_id_str, float pm1, float pm25, float pm4, float pm10,
                        float rh, float temp, float co2, float voltage, float hPa, uint32_t result_raw_NOx,uint32_t result_Raw_VOC, uint64_t now_ms);

int publish_sensor_data_B(const char *device_id_str, float pm1, float pm25, float pm4, float pm10,
                        float rh, float temp, float co2, float voltage,float hPa, uint32_t result_raw_NOx, uint32_t result_Raw_VOC, uint64_t now_ms);

int Publish_sensor_data_Gnss_pressure(const char *device_id_str, uint64_t now_ms);
						
/**@brief Initialize the MQTT client structure
 */
int client_init(struct mqtt_client *client);

/**@brief Initialize the file descriptor structure used by poll.
 */
int fds_init(struct mqtt_client *c, struct pollfd *fds);

/**@brief Function to publish data on the configured topic
 */
int data_publish(struct mqtt_client *c, enum mqtt_qos qos,
	uint8_t *data, size_t len, char *topic);

#endif /* _CONNECTION_H_ */
```
